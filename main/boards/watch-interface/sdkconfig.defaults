## main/boards/watch-interface/sdkconfig.defaults
```kconfig
# Watch Interface board defaults (ESP32-S3 N8R2, 8MB flash, 2MB QUAD PSRAM)
CONFIG_SPIRAM=y
CONFIG_SPIRAM_MODE_QUAD=y
# CONFIG_SPIRAM_MODE_OCT is not set
CONFIG_SPIRAM_SPEED_80M=y
CONFIG_SPIRAM_MALLOC_ALWAYSINTERNAL=2048
CONFIG_SPIRAM_MALLOC_RESERVE_INTERNAL=98304
CONFIG_SPIRAM_MEMTEST=n
CONFIG_FLASH_DEFAULT_ASSETS=y
CONFIG_USE_AFE_WAKE_WORD=y
CONFIG_SR_WN_WN9_HIJOY_TTS=y
CONFIG_ESPTOOLPY_FLASHSIZE_8MB=y
CONFIG_ESPTOOLPY_FLASHSIZE="8MB"
CONFIG_PARTITION_TABLE_CUSTOM_FILENAME="partitions/v2/8m.csv"
CONFIG_PARTITION_TABLE_FILENAME="partitions/v2/8m.csv"

# Display: SH1106 OLED 128x64 via I2C (shares I2C with PCA9685)
CONFIG_OLED_SH1106_128X64=y
```
